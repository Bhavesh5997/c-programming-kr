## zephyrproject/zephyr/dts/bindings/i2c/hello,driver.yaml
```yaml
description: HELLO DRIVER

compatible: "hello,driver"
properties:
  label:
    type: string
    required: true
  an_inte:
    type: int
    required: true
```
